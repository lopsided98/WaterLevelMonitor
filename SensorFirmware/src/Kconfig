## SensorFirmware/src/Kconfig
```kconfig
config BT_DEFAULT_PASSKEY
    int "Driver name"
    default 111111
    depends on BT_FIXED_PASSKEY
    help
        Default bluetooth fixed passkey

rsource "jsn_sr04t/Kconfig"
rsource "nrfx_adc_supply/Kconfig"
```

## SensorFirmware/src/jsn_sr04t/Kconfig
```kconfig
# Kconfig - JSN-SR04T Waterproof Ultrasonic Rangefinder configuration options

menuconfig JSN_SR04T
    bool "JSN-SR04T Waterproof Ultrasonic Rangefinder"
    depends on GPIO
    help
      Enable driver for the JSN-SR04T waterproof ultrasonic rangefinder.

if JSN_SR04T

config JSN_SR04T_NAME
    string "Driver name"
    default "JSN_SR04T"
    help
        Device name with which the sensor is identified.

config JSN_SR04T_GPIO_DEV_NAME
    string "Trig/echo GPIO device"
    default "GPIO_0"
    help
        The device name of the GPIO device to which the chip's trigger/echo pin
        is connected.

config JSN_SR04T_TRIG_GPIO_PIN_NUM
    int "Trig GPIO pin number"
    default 3
    help
        The number of the GPIO on which the chip's data pin is trigger pin is
        connected.

config JSN_SR04T_ECHO_GPIO_PIN_NUM
    int "Echo GPIO pin number"
    default 4
    help
        The number of the GPIO on which the chip's data pin is trigger/echo pin
        is connected.

config JSN_SR04T_EN_GPIO_PIN_NUM
    int "Regulator enable GPIO pin number"
    default 2
    help
        The number of the GPIO on which the voltage regulator's enable pin is
        connected.

config JSN_SR04T_ECHO_TIMEOUT
    int "Echo timeout in ms"
    default 12
    help
        Timeout in ms to wait for an echo

config JSN_SR04T_NS_PER_MM
    int "Echo time conversion factor"
    default 5882
    help
        Echo time conversion factor in nS per mm

endif # JSN_SR04T
```

## SensorFirmware/src/nrfx_adc_supply/Kconfig
```kconfig
# Kconfig - NRFx supply voltage measurement driver configuration options

menuconfig NRFX_ADC_SUPPLY
    bool "NRFx supply voltage measurement driver"
    depends on ADC_NRFX_ADC
    help
      Enable NRFx supply voltage measurement driver
```

## sensor/firmware/lib/Kconfig
```kconfig
# Copyright (c) 2026 Ben Wolsieffer
# SPDX-License-Identifier: GPL-3.0-or-later

rsource "drivers/Kconfig"
```

## sensor/firmware/lib/drivers/Kconfig
```kconfig
# Copyright (c) 2026 Ben Wolsieffer
# SPDX-License-Identifier: Apache-2.0

rsource "sensor/Kconfig"
```

## sensor/firmware/lib/drivers/sensor/Kconfig
```kconfig
# Copyright (c) 2026 Ben Wolsieffer
# SPDX-License-Identifier: Apache-2.0

rsource "jsn_sr04t/Kconfig"
```

## sensor/firmware/lib/drivers/sensor/jsn_sr04t/Kconfig
```kconfig
# Kconfig - JSN-SR04T Waterproof Ultrasonic Rangefinder configuration options

menuconfig JSN_SR04T
    bool "JSN-SR04T Waterproof Ultrasonic Rangefinder"
    depends on GPIO
    help
      Enable driver for the JSN-SR04T waterproof ultrasonic rangefinder.

if JSN_SR04T

config JSN_SR04T_ECHO_TIMEOUT
    int "Echo timeout in ms"
    default 12
    help
        Timeout in ms to wait for an echo

config JSN_SR04T_NS_PER_MM
    int "Echo time conversion factor"
    default 5882
    help
        Echo time conversion factor in nS per mm

endif # JSN_SR04T
```

## sensor/firmware/src/Kconfig
```kconfig
config BT_DEFAULT_PASSKEY
    int "Driver name"
    default 111111
    depends on BT_FIXED_PASSKEY
    help
        Default bluetooth fixed passkey

rsource "nrfx_adc_supply/Kconfig"
```
